## esp32-firmware/main/Kconfig.projbuild
```kconfig
menu "PictureFrame settings"

config FRAME_WS_BASE_URL
    string "WebSocket base URL"
    default "wss://frame.oesterlin.dev/ws"

config FRAME_ASSET_BASE_URL
    string "Frame asset base URL"
    default "https://frame.oesterlin.dev"

config FRAME_AUTH_KEY
    string "Default frame auth key"
    default ""

endmenu
```

## esp32-firmware/sdkconfig.defaults
```kconfig
CONFIG_ESPTOOLPY_FLASHSIZE_8MB=y
CONFIG_PARTITION_TABLE_CUSTOM=y
CONFIG_PARTITION_TABLE_CUSTOM_FILENAME="partitions.csv"
CONFIG_PARTITION_TABLE_FILENAME="partitions.csv"
CONFIG_BT_ENABLED=y
CONFIG_BT_NIMBLE_ENABLED=y

# Heartbeat task pauses the WebSocket while it makes HTTPS calls, so the
# default mbedtls fragment buffers are fine. We keep this comment as a
# reminder: do not enable CONFIG_MBEDTLS_DYNAMIC_BUFFER here — it conflicts
# with the streaming artifact reader which expects a 16 KB record buffer.
```
